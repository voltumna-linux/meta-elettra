## conf/layer.conf
```bitbake
# We have a conf and classes directory, add to BBPATH
BBPATH .= ":${LAYERDIR}"

# We have recipes-* directories, add to BBFILES
BBFILES += "${LAYERDIR}/recipes-*/*/*.bb \
	    ${LAYERDIR}/recipes-*/*/*.bbappend"

BBFILE_COLLECTIONS += "elettra"
BBFILE_PATTERN_elettra = "^${LAYERDIR}/"
BBFILE_PRIORITY_elettra = "10"

LAYERSERIES_COMPAT_elettra = "kirkstone"

# This should only be incremented on significant changes that will
# cause compatibility issues with other layers
LAYERVERSION_elettra = "1"

LAYERDEPENDS_elettra = "core"
```
